## app/boards/shields/pancake/Kconfig.defconfig
```kconfig
# Copyright (c) 2020 The ZMK Contributors
# SPDX-License-Identifier: MIT

if SHIELD_PANCAKE

config ZMK_KEYBOARD_NAME
	default "PANCAKE"

config ZMK_USB
	default y

endif
```
